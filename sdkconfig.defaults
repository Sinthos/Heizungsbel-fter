## sdkconfig.defaults
```kconfig
# ESP32-C6 Zigbee Fan Switch - SDK Configuration Defaults
# For ESP-IDF v5.1+ with Zigbee support

# =============================================================================
# Target Configuration
# =============================================================================
CONFIG_IDF_TARGET="esp32c6"

# =============================================================================
# Partition Table
# =============================================================================
CONFIG_PARTITION_TABLE_CUSTOM=y
CONFIG_PARTITION_TABLE_CUSTOM_FILENAME="partitions.csv"

# =============================================================================
# Zigbee Configuration
# =============================================================================
# Enable Zigbee
CONFIG_ZB_ENABLED=y

# Set device as End Device (not Coordinator or Router)
CONFIG_ZB_ZED=y

# Zigbee Radio Configuration
CONFIG_ZB_RADIO_MODE_NATIVE=y

# =============================================================================
# IEEE 802.15.4 Radio Configuration
# =============================================================================
CONFIG_IEEE802154_ENABLED=y

# =============================================================================
# NVS (Non-Volatile Storage) Configuration
# =============================================================================
CONFIG_NVS_ENCRYPTION=n

# =============================================================================
# ESP System Settings
# =============================================================================
# Increase main task stack size for Zigbee operations
CONFIG_ESP_MAIN_TASK_STACK_SIZE=4096

# =============================================================================
# Log Level Configuration
# =============================================================================
CONFIG_LOG_DEFAULT_LEVEL_INFO=y
CONFIG_LOG_DEFAULT_LEVEL=3

# =============================================================================
# FreeRTOS Configuration
# =============================================================================
CONFIG_FREERTOS_HZ=1000

# =============================================================================
# Serial Flasher Configuration
# =============================================================================
CONFIG_ESPTOOLPY_FLASHSIZE_4MB=y
CONFIG_ESPTOOLPY_FLASHSIZE="4MB"
```
